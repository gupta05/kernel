## Documentation/devicetree/bindings/mmc/sdhci-msm.txt
```
* Qualcomm SDHCI controller (sdhci-msm)

This file documents differences between the core properties in mmc.txt
and the properties used by the sdhci-msm driver.

Required properties:
- compatible: should contain "qcom,sdhci-msm"
- reg: should contain SDHC, SD Core register map
- reg-names: indicates various resources passed to driver (via reg proptery) by name
	"reg-names" examples are "hc_mem" and "core_mem"
- interrupts: should contain SDHC interrupts
- interrupt-names: indicates interrupts passed to driver (via interrupts property) by name
	"interrupt-names" examples are "hc_irq" and "pwr_irq"
- vdd-supply: phandle to the regulator for the vdd (flash core voltage) supply.
- vddio-supply: phandle to the regulator for the vdd-io (i/o voltage) supply.
- pinctrl-names: Should contain only one value - "default".
- pinctrl-0: Should specify pin control groups used for this controller.
- clocks: A list of phandle + clock-specifier pairs for the clocks listed in clock-names
- clock-names: Should contain the following:
	"iface" - Main peripheral bus clock (PCLK/HCLK - AHB Bus clock) (required)
	"core"	- SDC MMC clock (MCLK) (required)
	"bus"	- SDCC bus voter clock (optional)

Optional properties:
- qcom,bus-speed-mode: specifies the supported bus speed modes by host
	The supported bus speed modes are :
	"HS200_1p8v" - indicates that host can support HS200 at 1.8v
	"HS200_1p2v" - indicates that host can support HS200 at 1.2v
	"DDR_1p8v" - indicates that host can support DDR mode at 1.8v
	"DDR_1p2v" - indicates that host can support DDR mode at 1.2v

- qcom,{vdd,vddio}-always-on - specifies whether the supply should be kept "on" always.
- qcom,{vdd,vddio}-lpm-sup - specifies whether the supply can be kept in low power mode.
- qcom,{vdd,vddio}-voltage-level - specifies voltage levels for the supply.
	Should be specified in pairs (min, max), units uV.
- qcom,{vdd,vddio}-current-level - specifies load levels for the supply in lpm
	or high power mode (hpm). Should be specified in pairs (lpm, hpm), units uA.

Example:

	aliases {
		sdhc1 = &sdhc_1;
	};

	sdhc_1: qcom,sdhc@f9824900 {
		compatible = "qcom,sdhci-msm";
		reg = <0xf9824900 0x11c>, <0xf9824000 0x800>;
		reg-names = "hc_mem", "core_mem";
		interrupts = <0 123 0>, <0 138 0>;
		interrupt-names = "hc_irq", "pwr_irq";
		bus-width = <4>;
		non-removable;

		vdd-supply = <&pm8941_l21>;
		vddio-supply = <&pm8941_l13>;
		qcom,vdd-voltage-level = <2950000 2950000>;
		qcom,vdd-current-level = <9000 800000>;
		qcom,vddio-always-on;
		qcom,vddio-lpm-sup;
		qcom,vddio-voltage-level = <1800000 2950000>;
		qcom,vddio-current-level = <6 22000>;
		qcom,bus-speed-mode = "HS200_1p8v", "DDR_1p8v";

		pinctrl-names = "default"
		pinctrl-0 = <&sdc1_clk &sdc1_cmd &sdc1_data>;

		clocks = <&iface>, <&core>, <&bus>;
		clock-names = "iface", "core", "bus";

	};
```

## Documentation/devicetree/bindings/pinctrl/qcom,msm8960-pinctrl.txt
```
Qualcomm MSM8960 TLMM block

Required properties:
- compatible: "qcom,msm8960-pinctrl"
- reg: Should be the base address and length of the TLMM block.
- interrupts: Should be the parent IRQ of the TLMM block.
- interrupt-controller: Marks the device node as an interrupt controller.
- #interrupt-cells: Should be two.
- gpio-controller: Marks the device node as a GPIO controller.
- #gpio-cells : Should be two.
                The first cell is the gpio pin number and the
                second cell is used for optional parameters.

Please refer to ../gpio/gpio.txt and ../interrupt-controller/interrupts.txt for
a general description of GPIO and interrupt bindings.

Please refer to pinctrl-bindings.txt in this directory for details of the
common pinctrl bindings used by client devices, including the meaning of the
phrase "pin configuration node".

Qualcomm's pin configuration nodes act as a container for an abitrary number of
subnodes. Each of these subnodes represents some desired configuration for a
pin, a group, or a list of pins or groups. This configuration can include the
mux function to select on those pin(s)/group(s), and various pin configuration
parameters, such as pull-up, drive strength, etc.

The name of each subnode is not important; all subnodes should be enumerated
and processed purely based on their content.

Each subnode only affects those parameters that are explicitly listed. In
other words, a subnode that lists a mux function but no pin configuration
parameters implies no information about any pin configuration parameters.
Similarly, a pin subnode that describes a pullup parameter implies no
information about e.g. the mux function.


The following generic properties as defined in pinctrl-bindings.txt are valid
to specify in a pin configuration subnode:
 pins, function, bias-disable, bias-pull-down, bias-pull,up, drive-strength,
 output-low, output-high.

Non-empty subnodes must specify the 'pins' property.
Note that not all properties are valid for all pins.


Valid values for pins are:
  gpio0-gpio151
    Supports mux, bias, drive-strength and output level

  sdc1_clk, sdc1_cmd, sdc1_data, sdc3_clk, sdc3_cmd, sdc3_data
    Supports bias and drive-strength

Valid values for function are:
  audio_pcm, bt, cam_mclk0, cam_mclk1, cam_mclk2, codec_mic_i2s,
  codec_spkr_i2s, ext_gps, fm, gps_blanking, gps_pps_in, gps_pps_out,
  gp_clk_0a, gp_clk_0b, gp_clk_1a, gp_clk_1b, gp_clk_2a, gp_clk_2b, gp_mn,
  gp_pdm_0a, gp_pdm_0b, gp_pdm_1a, gp_pdm_1b, gp_pdm_2a, gp_pdm_2b, gsbi1,
  gsbi1_spi_cs1_n, gsbi1_spi_cs2a_n, gsbi1_spi_cs2b_n, gsbi1_spi_cs3_n, gsbi2,
  gsbi2_spi_cs1_n, gsbi2_spi_cs2_n, gsbi2_spi_cs3_n, gsbi3, gsbi4,
  gsbi4_3d_cam_i2c_l, gsbi4_3d_cam_i2c_r, gsbi5, gsbi5_3d_cam_i2c_l,
  gsbi5_3d_cam_i2c_r, gsbi6, gsbi7, gsbi8, gsbi9, gsbi10, gsbi11,
  gsbi11_spi_cs1a_n, gsbi11_spi_cs1b_n, gsbi11_spi_cs2a_n, gsbi11_spi_cs2b_n,
  gsbi11_spi_cs3_n, gsbi12, hdmi_cec, hdmi_ddc_clock, hdmi_ddc_data,
  hdmi_hot_plug_detect, hsic, mdp_vsync, mi2s, mic_i2s, pmb_clk, pmb_ext_ctrl,
  ps_hold, rpm_wdog, sdc2, sdc4, sdc5, slimbus1, slimbus2, spkr_i2s, ssbi1,
  ssbi2, ssbi_ext_gps, ssbi_pmic2, ssbi_qpa1, ssbi_ts, tsif1, tsif2, ts_eoc,
  usb_fs1, usb_fs1_oe, usb_fs1_oe_n, usb_fs2, usb_fs2_oe, usb_fs2_oe_n,
  vfe_camif_timer1_a, vfe_camif_timer1_b, vfe_camif_timer2, vfe_camif_timer3_a,
  vfe_camif_timer3_b, vfe_camif_timer4_a, vfe_camif_timer4_b,
  vfe_camif_timer4_c, vfe_camif_timer5_a, vfe_camif_timer5_b,
  vfe_camif_timer6_a, vfe_camif_timer6_b, vfe_camif_timer6_c,
  vfe_camif_timer7_a, vfe_camif_timer7_b, vfe_camif_timer7_c, wlan


Example:

	msmgpio: pinctrl@800000 {
		compatible = "qcom,msm8960-pinctrl";
		reg = <0x800000 0x4000>;

		gpio-controller;
		#gpio-cells = <2>;
		interrupt-controller;
		#interrupt-cells = <2>;
                interrupts = <0 32 0x4>;

		pinctrl-names = "default";
		pinctrl-0 = <&debug_uart>;

		debug_uart: debug_uart {
			mux {
				pins = "gpio34", "gpio35";
				function = "gsbi8";
			};

			tx {
				pins = "gpio34";
				drive-strength = <4>;
				bias-disable;
			};

			rx {
				pins = "gpio35";
				drive-strength = <2>;
				bias-pull-up;
			};
		};
	};
```

## Documentation/devicetree/bindings/pinctrl/qcom,pm8xxx-gpio.txt
```
Qualcomm PM8XXX GPIO block

This binding describes the GPIO block(s) found in the 8xxx series of pmics from
Qualcomm.

- compatible:
	Usage: required
	Value type: <string>
	Definition: must be one of:
			"qcom,pm8018-gpio"
			"qcom,pm8038-gpio"
			"qcom,pm8058-gpio"
			"qcom,pm8917-gpio"
			"qcom,pm8921-gpio"

- reg:
	Usage: required
	Value type: <u32>
	Definition: Register base of the gpio block

- interrupts:
	Usage: required
	Value type: <prop-encoded-array>
	Definition: Must contain an array of encoded interrupt specifiers for
		    each available gpio

- gpio-controller:
	Usage: required
	Value type: <none>
	Definition: Mark the device node as a GPIO controller

- #gpio-cells:
	Usage: required
	Value type: <u32>
	Definition: Must be 2;
		    the first cell will be used to define gpio number and the
		    second denotes the flags for this gpio

Please refer to ../gpio/gpio.txt and ../interrupt-controller/interrupts.txt for
a general description of GPIO and interrupt bindings.

Please refer to pinctrl-bindings.txt in this directory for details of the
common pinctrl bindings used by client devices, including the meaning of the
phrase "pin configuration node".

The pin configuration nodes act as a container for an abitrary number of
subnodes. Each of these subnodes represents some desired configuration for a
pin or a list of pins. This configuration can include the
mux function to select on those pin(s), and various pin configuration
parameters, s listed below.


SUBNODES:

The name of each subnode is not important; all subnodes should be enumerated
and processed purely based on their content.

Each subnode only affects those parameters that are explicitly listed. In
other words, a subnode that lists a mux function but no pin configuration
parameters implies no information about any pin configuration parameters.
Similarly, a pin subnode that describes a pullup parameter implies no
information about e.g. the mux function.

The following generic properties as defined in pinctrl-bindings.txt are valid
to specify in a pin configuration subnode:

- pins:
	Usage: required
	Value type: <string-array>
	Definition: List of gpio pins affected by the properties specified in
		    this subnode.  Valid pins are:
			gpio1-gpio6 for pm8018
			gpio1-gpio12 for pm8038
			gpio1-gpio40 for pm8058
			gpio1-gpio38 for pm8917
			gpio1-gpio44 for pm8921

- function:
	Usage: optional
	Value type: <string>
	Definition: Specify the alternative function to be configured for the
		    specified pins.  Valid values are:
			"normal",
			"paired",
			"func1",
			"func2",
			"dtest1",
			"dtest2",
			"dtest3",
			"dtest4"

- bias-disable:
	Usage: optional
	Value type: <none>
	Definition: The specified pins should be configued as no pull.

- bias-pull-down:
	Usage: optional
	Value type: <none>
	Definition: The specified pins should be configued as pull down.

- bias-pull-up:
	Usage: optional
	Value type: <u32> (optional)
	Definition: The specified pins should be configued as pull up. An
		    optional argument can be used to configure the strength.
		    Valid values are; as defined in
		    <dt-bindings/pinctrl/qcom,pm8xxx-gpio.h>:
		    1: 30uA			(PM8XXX_GPIO_PULL_UP_30)
		    2: 1.5uA			(PM8XXX_GPIO_PULL_UP_1P5)
		    3: 31.5uA			(PM8XXX_GPIO_PULL_UP_31P5)
		    4: 1.5uA + 30uA boost	(PM8XXX_GPIO_PULL_UP_1P5_30)

- bias-high-impedance:
	Usage: optional
	Value type: <none>
	Definition: The specified pins will put in high-Z mode and disabled.

- input-enable:
	Usage: optional
	Value type: <none>
	Definition: The specified pins are put in input mode.

- output-high:
	Usage: optional
	Value type: <none>
	Definition: The specified pins are configured in output mode, driven
		    high.

- output-low:
	Usage: optional
	Value type: <none>
	Definition: The specified pins are configured in output mode, driven
		    low.

- power-source:
	Usage: optional
	Value type: <u32>
	Definition: Selects the power source for the specified pins. Valid
		    power sources are, as defined in
		    <dt-bindings/pinctrl/qcom,pm8xxx-gpio.h>:
			0: bb (PM8XXX_GPIO_VIN_BB)
				valid for pm8038, pm8058, pm8917, pm8921
			1: ldo2 (PM8XXX_GPIO_VIN_L2)
				valid for pm8018, pm8038, pm8917,pm8921
			2: ldo3 (PM8XXX_GPIO_VIN_L3)
				valid for pm8038, pm8058, pm8917, pm8921
			3: ldo4 (PM8XXX_GPIO_VIN_L4)
				valid for pm8018, pm8917, pm8921
			4: ldo5 (PM8XXX_GPIO_VIN_L5)
				valid for pm8018, pm8058
			5: ldo6 (PM8XXX_GPIO_VIN_L6)
				valid for pm8018, pm8058
			6: ldo7 (PM8XXX_GPIO_VIN_L7)
				valid for pm8058
			7: ldo8 (PM8XXX_GPIO_VIN_L8)
				valid for pm8018
			8: ldo11 (PM8XXX_GPIO_VIN_L11)
				valid for pm8038
			9: ldo14 (PM8XXX_GPIO_VIN_L14)
				valid for pm8018
			10: ldo15 (PM8XXX_GPIO_VIN_L15)
				valid for pm8038, pm8917, pm8921
			11: ldo17 (PM8XXX_GPIO_VIN_L17)
				valid for pm8038, pm8917, pm8921
			12: smps3 (PM8XXX_GPIO_VIN_S3)
				valid for pm8018, pm8058
			13: smps4 (PM8XXX_GPIO_VIN_S4)
				valid for pm8921
			14: vph (PM8XXX_GPIO_VIN_VPH)
				valid for pm8018, pm8038, pm8058, pm8917 pm8921

- drive-strength:
	Usage: optional
	Value type: <u32>
	Definition: Selects the drive strength for the specified pins. Value
		    drive strengths are:
			0: no	(PM8XXX_GPIO_STRENGTH_NO)
			1: high	(PM8XXX_GPIO_STRENGTH_HIGH)
			2: medium	(PM8XXX_GPIO_STRENGTH_MED)
			3: low	(PM8XXX_GPIO_STRENGTH_LOW)

- drive-push-pull:
	Usage: optional
	Value type: <none>
	Definition: The specified pins are configured in push-pull mode.

- drive-open-drain:
	Usage: optional
	Value type: <none>
	Definition: The specified pins are configured in open-drain mode.


Example:

	pm8921_gpio: gpio@150 {
		compatible = "qcom,pm8921-gpio";
		reg = <0x150>;
		interrupts = <192 1>, <193 1>, <194 1>,
			     <195 1>, <196 1>, <197 1>,
			     <198 1>, <199 1>, <200 1>,
			     <201 1>, <202 1>, <203 1>,
			     <204 1>, <205 1>, <206 1>,
			     <207 1>, <208 1>, <209 1>,
			     <210 1>, <211 1>, <212 1>,
			     <213 1>, <214 1>, <215 1>,
			     <216 1>, <217 1>, <218 1>,
			     <219 1>, <220 1>, <221 1>,
			     <222 1>, <223 1>, <224 1>,
			     <225 1>, <226 1>, <227 1>,
			     <228 1>, <229 1>, <230 1>,
			     <231 1>, <232 1>, <233 1>,
			     <234 1>, <235 1>;

		gpio-controller;
		#gpio-cells = <2>;

		pm8921_gpio_keys: gpio-keys {
			volume-keys {
				pins = "gpio20", "gpio21";
				function = "normal";

				input-enable;
				bias-pull-up;
				drive-push-pull;
				drive-strength = <PM8XXX_GPIO_STRENGTH_NO>;
				power-source = <PM8XXX_GPIO_VIN_S4>;
			};
		};
	};
```

## Documentation/devicetree/bindings/pwm/pwm-pm8xxx.txt
```
Qualcomm QPNP PWM controller

Required properties:
- compatible: should be "qcom,pm8xxx-pwm"
- #pwm-cells: should be 2. See pwm.txt in this directory for a description of
  the cells format.
- reg: base address of lookup table

Optional properties:
- qcom,lut: should contain a 16 bit array of lookup table entries, up to 64.

Required subnode properties:
- qcom,channel-id: should be an ID within the range 0-7
- qcom,lut-range: starting index and length of lookup table for ramping
- reg: base address of register map

Optional subnode properties:
- qcom,ramp-repeat: boolean; repeat the ramp after completion
- qcom,ramp-pingpong: boolean; repeat ramp in reverse after completion
- qcom,ramp-reverse: boolean; iterate the ramp in reverse on start
- qcom,ramp-duration: mS of single ramp iteration
- qcom,ramp-pause-top: mS to pause at top of ramp before continuing
- qcom,ramp-pause-bottom: mS to pause at bottom of ramp before continuing

Example:

pm8xxx-pwm@b040 {
	compatible = "qcom,pm8xxx-pwm";
	reg = <0xb040>;
	#address-cells = <1>;
	#size-cells = <0>;
	#pwm-cells = <2>;
	qcom,lut = /bits/ 16 <
		0x000 0x07f 0x0bf 0x0ff 0x13f 0x17f 0x1bf 0x1ff
	>;

	pwm@b500 {
		reg = <0xb500>;
		qcom,channel-id = <4>;
		qcom,ramp-repeat;
		qcom,ramp-pingpong;
		qcom,ramp-duration = <192>;
		qcom,lut-range = <0 8>;
	};
};
```
