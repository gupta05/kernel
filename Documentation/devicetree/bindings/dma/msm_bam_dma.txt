## Documentation/devicetree/bindings/remoteproc/qcom,wcnss-pil.txt
```
Qualcomm WCNSS Peripheral Image Loader

This document defines the binding for a component that loads and boots firmware
on the Qualcomm WCNSS core.

- compatible:
	Usage: required
	Value type: <string>
	Definition: must be one of:
		    "qcom,riva-pil",
		    "qcom,pronto-v1-pil",
		    "qcom,pronto-v2-pil"

- reg:
	Usage: required
	Value type: <prop-encoded-array>
	Definition: base address and size of riva/pronto PMU registers

- interrupts-extended:
	Usage: required
	Value type: <prop-encoded-array>
	Definition: should specify the watchdog, fatal, ready, handover and
		    stop-ack IRQs, in order.

- interrupt-names:
	Usage: required
	Value type: <stringlist>
	Definition: should be "wdog", "fatal", "ready", "handover", "stop-ack"

- clocks:
	Usage: required
	Value type: <prop-encoded-array>
	Definition: should specify the xo clock and optionally the rf_clk

- clock-names:
	Usage: requireduired
	Value type: <stringlist>
	Definition: should be "xo", optionally followed by "rf"

- qcom,firmware-name:
	Usage: required
	Value type: <string>
	Definition: name of the firmware to be loaded

- qcom,crash-reason:
	Usage: required
	Value type: <u32>
	Definition: SMEM item used by WCNSS for storing the error messages upon
		    a fatal exception

- qcom,iris-vddxo-supply:
- qcom,iris-vddrfa-supply:
- qcom,iris-vddpa-supply:
- qcom,iris-vdddig-supply:
- qcom,pronto-vddmx-supply:
- qcom,pronto-vddcx-supply:
- qcom,pronto-vddpx-supply:
	Usage: required
	Value type: <phandle>
	Definition: reference to the regulators to be held on behalf of the
		    booting of the WCNSS core

- qcom,state:
	Usage: required
	Value type: <prop-encoded-array>
	Definition: reference to the SMEM state used to indicate to WCNSS that
		    it should shut down

- qcom,state-names:
	Usage: required
	Value type: <stringlist>
	Definition: should be "stop"

= EXAMPLE

pronto_rproc@fb21b000 {
	compatible = "qcom,pronto-v2-pil";
	reg = <0xfb21b000 0x3000>;

	interrupts-extended = <&intc 0 149 1>,
			      <&wcnss_smp2p_slave 0 0>,
			      <&wcnss_smp2p_slave 1 0>,
			      <&wcnss_smp2p_slave 2 0>,
			      <&wcnss_smp2p_slave 3 0>;
	interrupt-names = "wdog", "fatal", "ready", "handover", "stop-ack";

	clocks = <&rpmcc RPM_CXO_CLK_SRC>, <&rpmcc RPM_CXO_A2>;
	clock-names = "xo", "rf";

	qcom,firmware-name = "wcnss";

	qcom,crash-reason = <422>;

	qcom,iris-vddxo-supply = <&pm8941_l6>;
	qcom,iris-vddrfa-supply = <&pm8941_l11>;
	qcom,iris-vddpa-supply = <&pm8941_l19>;
	qcom,iris-vdddig-supply = <&pm8941_s3>;
	qcom,pronto-vddmx-supply = <&pm8841_s1>;
	qcom,pronto-vddcx-supply = <&pm8841_s2>;
	qcom,pronto-vddpx-supply = <&pm8941_s3>;

	qcom,state = <&wcnss_smp2p_out 0>;
	qcom,state-names = "stop";

	pinctrl-names = "default";
	pinctrl-0 = <&wcnss_pin_a>;
};
```

## Documentation/devicetree/bindings/soc/qcom/qcom,smd.txt
```
Qualcomm Shared Memory Driver (SMD) binding

This binding describes the Qualcomm Shared Memory Driver, a fifo based
communication channel for sending data between the various subsystems in
Qualcomm platforms.

- compatible:
	Usage: required
	Value type: <stringlist>
	Definition: must be "qcom,smd"

- qcom,smem:
	Usage: required
	Value type: <prop-encoded-array>
	Definition: reference to a smem node managing the shared memory items
		    used for smd

= EDGES

Each subnode of the SMD node represents a remote subsystem, i.e. a remote
processor of some sort - in SMD language called an "edge". The name of the
edges are not important.

- interrupts:
	Usage: required
	Value type: <prop-encoded-array>
	Definition: should specify the IRQ used by the remote processor to
		    signal this processor about communication related updates

- qcom,ipc:
	Usage: required
	Value type: <prop-encoded-array>
	Definition: three entries specifying the outgoing ipc bit used for
		    signaling the remote processor:
		    - phandle to a syscon node representing the apcs registers
		    - u32 representing offset to the register within the syscon
		    - u32 representing the ipc bit within the register

- qcom,smd-edge:
	Usage: required
	Value type: <u32>
	Definition: an identifier representing the remote processor

= SMD DEVICES

In turn, subnodes of the "edges" represent devices tied to SMD channels on that
"edge". The names of the devices are not important. The properties of these
nodes are defined by the individual bindings for the SMD devices - but must
contain the following property:

- qcom,smd-channels:
	Usage: required
	Value type: <stringlist>
	Definition: a list of channels tied to this device, used for matching
		    the device to channels

= EXAMPLE

The following example represents a smd node, with one edge representing the
"rpm" subsystem. For the "rpm" subsystem we have a device tied to the
"rpm_request" channel.

        smd {
                compatible = "qcom,smd";
                qcom,smem = <&smem>;

                rpm {
                        interrupts = <0 168 1>;
                        qcom,ipc = <&apcs 8 0>;
                        qcom,smd-edge = <15>;

                        rpm_requests {
                                compatible = "qcom,rpm-msm8974";
                                qcom,smd-channels = "rpm_requests";

                                #address-cells = <1>;
                                #size-cells = <0>;

				...
			};
		};
	};
```

## Documentation/devicetree/bindings/soc/qcom/qcom,smem.txt
```
Qualcomm Shared Memory binding

This binding describes the Qualcomm Shared Memory, used to share data between
various subsystems and OSes in Qualcomm platforms.

- compatible:
	Usage: required
	Value type: <stringlist>
	Definition: must be:
		    "qcom,smem"

- reg:
	Usage: required
	Value type: <prop-encoded-array>
	Definition: base address and size pair for each area representing the
		    shared memory. The first pair will must represent the "main"
		    area, where the shared memory header and table-of-content
		    can be found.

- hwspinlocks:
	Usage: required
	Value type: <prop-encoded-array>
	Definition: reference to a hwspinlock used to protect allocations from
		    the shared memory

= EXAMPLE

        smem: smem@fa00000 {
                compatible = "qcom,smem";
                reg = <0x0fa00000 0x200000>,
                      <0xfc428000 0x4000>;

                hwlocks = <&tcsr_mutex 3>;
        };
```

## Documentation/devicetree/bindings/spmi/qcom,spmi-pmic-arb.txt
```
Qualcomm SPMI Controller (PMIC Arbiter)

The SPMI PMIC Arbiter is found on the Snapdragon 800 Series.  It is an SPMI
controller with wrapping arbitration logic to allow for multiple on-chip
devices to control a single SPMI master.

The PMIC Arbiter can also act as an interrupt controller, providing interrupts
to slave devices.

See spmi.txt for the generic SPMI controller binding requirements for child
nodes.

Required properties:
- compatible : should be "qcom,spmi-pmic-arb".
- reg-names  : should be "core", "intr", "cnfg"
- reg : offset and length of the PMIC Arbiter Core register map.
- reg : offset and length of the PMIC Arbiter Interrupt controller register map.
- reg : offset and length of the PMIC Arbiter Configuration register map.
- #address-cells : must be set to 1
- #size-cells : must be set to 0
- interrupt-controller : indicates the PMIC arbiter is an interrupt controller
- #interrupt-cells = <4>:  interrupts are specified as a 4-tuple:
    cell 1: slave ID for the requested interrupt (0-15)
    cell 2: peripheral ID for requested interrupt (0-255)
    cell 3: the requested peripheral interrupt (0-7)
    cell 4: interrupt flags indicating level-sense information, as defined in
            dt-bindings/interrupt-controller/irq.h

Example:

	qcom,spmi@fc4c0000 {
		compatible = "qcom,spmi-pmic-arb";
		reg-names = "core", "intr", "cnfg";
		reg = <0xfc4cf000 0x1000>,
		      <0Xfc4cb000 0x1000>,
		      <0Xfc4ca000 0x1000>;
		#address-cells = <1>;
		#size-cells = <0>;

		interrupt-controller;
		#interrupt-cells = <4>;
	};
```

## drivers/soc/qcom/Kconfig
```kconfig
#
# QCOM Soc drivers
#
config QCOM_GSBI
        tristate "QCOM General Serial Bus Interface"
        depends on ARCH_QCOM
        help
          Say y here to enable GSBI support.  The GSBI provides control
          functions for connecting the underlying serial UART, SPI, and I2C
          devices to the output pins.

config QCOM_WCNSS_CTRL
	tristate "Qualcomm WCNSS control driver"
	depends on QCOM_SMD
	help
	  Test driver for the WCNSS_CTRL smd channel
```
