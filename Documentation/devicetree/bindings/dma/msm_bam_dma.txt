## Documentation/devicetree/bindings/dma/msm_bam_dma.txt
```
MSM BAM DMA controller

Required properties:
- compatible: Should be "qcom,bam"
- reg: Address range for DMA registers
- interrupts: single interrupt for this controller
- #dma-cells: must be <3>
- clocks: required clock
- clock-names: name of clock

Example:

	dma0: dma@f9984000 = {
		compatible = "qcom,bam";
		reg = <0xf9984000 0x15000>;
		interrupts = <0 94 0>;
		clocks = <&bam_dma_ahb_cxc>;
		clock-names = "bam_clk";
		#dma-cells = <3>;
	};

Client:
Required properties:
- dmas: List of dma channel requests
- dma-names: Names of aforementioned requested channels

Clients must use the format described in the dma.txt file, using a four cell
specifier for each channel.

The four cells in order are:
  1. A phandle pointing to the DMA controller
  2. The channel number
  3. The execution environment value for this channel.
  4. Direction of the fixed unidirectional channel
     0 - Memory to Device
     1 - Device to Memory

Example:
	serial@f991e000 {
		compatible = "qcom,msm-uart";
		reg = <0xf991e000 0x1000>
			<0xf9944000 0x19000>;
		interrupts = <0 108 0>;
		clocks = <&blsp1_uart2_apps_cxc>, <&blsp1_ahb_cxc>;
		clock-names = "gsbi_uart_clk", "gsbi_pclk";

		dmas = <&dma0 0 0 1>, <&dma0 1 0 0>;
		dma-names = "rx", "tx";
	};
```

## Documentation/devicetree/bindings/hwlock/msm-tcsr-mutex.txt
```
Qualcomm MSM Hardware Mutex Block:

The hardware block provides mutexes utilized between different processors
on the SoC as part of the communication protocol used by these processors.

Required properties:
- compatible: should be "qcom,tcsr-mutex"
- reg: Should contain registers location and length of mutex registers
- reg-names:
	"mutex-base"  - string to identify mutex registers
- qcom,num-locks: the number of locks/mutexes supported

Example:

	hwlock@fd484000 {
		compatible = "qcom,tcsr-mutex";
		reg = <0xfd484000 0x1000>;
		reg-names = "mutex-base";
		qcom,num-locks = <32>;
	};
```

## Documentation/devicetree/bindings/hwlock/qcom-hwspinlock.txt
```
Qualcomm Hardware Mutex Block:

The hardware block provides mutexes utilized between different processors
on the SoC as part of the communication protocol used by these processors.

- compatible:
	Usage: required
	Value type: <string>
	Definition: must be one of:
		    "qcom,sfpb-mutex",
		    "qcom,tcsr-mutex"

- reg:
	Usage: required
	Value type: <prop-encoded-array>
	Definition: base address and size of the mutex registers

- reg-names:
	Usage: required
	Value type: <string>
	Definition: must be "mutex-base"

- hwlock-base-id:
	Usage: optional
	Value type: <u32>
	Definition: base id of the hwlock device
		    (hwlock standard property, see hwlock.txt)

- #hwlock-cells:
	Usage: required
	Value type: <u32>
	Definition: must be 1, the specified cell represent the lock id
		    (hwlock standard property, see hwlock.txt)

- hwlock-num-locks:
	Usage: required
	Value type: <u32>
	Definition: the number of locks/mutex available in this block
		    (hwlock standard property, see hwlock.txt)

Example:

	hwlock@fd484000 {
		compatible = "qcom,tcsr-mutex";
		reg = <0xfd484000 0x1000>;
		reg-names = "mutex-base";

		hwlock-num-locks = <8>;
		#hwlock-cells = <1>;
	};
```

## Documentation/devicetree/bindings/leds/leds-pm8xxx-pwm.txt
```
Qualcomm PM8xxx LED connected to PWM

Required properties:
- compatible: should be "qcom,pm8xxx-pwm-led".
- reg: Address where the registers for the RGB LEDs are located

Each LED is represented as a sub-node of the pm8xxx pwm device.

LED sub-node required properties:
- pwms: PWM property pointing to the the PWM device according to the pwmchip
  implementation
  See Documentation/devicetree/bindings/pwm/pwm.txt
- qcom,id: One of "red", "green", or "blue" to specify which LED this is
  internally connected to.

LED sub-node optional properties:
- pwm-names: Name to be used by the PWM subsystem for the specifed PWMs
  See Documentation/devicetree/bindings/pwm/pwm.txt
- label: The label for this led
  See Documentation/devicetree/bindings/leds/common.txt
- linux,default-trigger: Default trigger assigned to the LED
  See Documentation/devicetree/bindings/leds/common.txt

Example:

pm8xxx_pwm: pm8xxx-pwm@b040 {
	compatible = "qcom,pm8xxx-pwm";
	#pwm-cells = <2>;
	...
};

pm8xxx-pwm-led@d000 {
	compatible = "qcom,pm8xxx-pwm-led";
	reg = <0xd000>;
	charger-led {
		label = "charger";
		pwms = <&pm8xxx_pwm 6 1000>;
		qcom,id = "red";
	};
};
```

## Documentation/devicetree/bindings/leds/sanyo,lc898300xa.txt
```
Binding for Sanyo LC898300XA linear vibrator chip

Required properties:
- compatible: "sanyo,lc898300xa"
- reg: I2C slave address
- label:  (optional)
  see Documentation/devicetree/bindings/leds/common.txt
- linux,default-trigger: (optional)
  see Documentation/devicetree/bindings/leds/common.txt
- sanyo,resonance-frequency:
- sanyo,startup-time:
- sanyo,break-time:
- sanyo,break-power:
- sanyo,atbr:

Examples:

leds {
	compatible = "sanyo,lc898300xa";
	reg = <0x49>;
	label = "vibrator";
	linux,default-trigger = "transient";
	sanyo,resonance-frequency = <150>;
	sanyo,startup-time = <10>;
	sanyo,break-time = <2>;
	sanyo,break-power = <15>;
};
```

## Documentation/devicetree/bindings/mfd/lm3533.txt
```
Texas Instruments LM3533 binding

This binding describes the Texas Instruments LM3533, a lighting power solution
for smartphone handsets. The common properties are described directly in the
node, while each individual component are described in an optional subnode.

- compatible:
	Usage: required
	Value type: <stringlist>
	Definition: must be:
		    "ti,lm3533"

- reg:
	Usage: required
	Value type: <u32>
	Definition: i2c address of the LM3533 chip

- als-supply:
	Usage: optional
	Value type: <prop-encoded-array>
	Definition: reference to regulator powering the V_als input; as
		    specified in "../regulator/regulator.txt"

- hwen-gpios:
	Usage: required
	Value type: <prop-encoded-array>
	Definition: reference to gpio pin connected to the HWEN input; as
		    specified in "../gpio/gpio.txt"

- ti,boost-freq-hz:
	Usage: required
	Value type: <u32>
	Definition: switch-frequency of the boost converter, must be either:
		    500000 or 1000000

- ti,boost-ovp-mv:
	Usage: required
	Value type: <u32>
	Definition: over-voltage protection limit, in mV. Must be one of:
		    16000, 24000, 32000 or 40000

- #address-cells:
	Usage: required
	Value type: <u32>
	Definition: must be 1

- #size-cells:
	Usage: required
	Value type: <u32>
	Definition: must be 0

= ALS SUBNODE
The ambient light sensor subnode must be named "als", it carries the light
sensor related properties.

- ti,als-resistance-ohm:
	Usage: required (unless ti,pwm-mode is specified)
	Value type: <u32>
	Definition: specifies the resistor value (R_als), in Ohm. Valid values
		    ranges from 200000 to 1574 Ohm.

- ti,pwm-mode:
	Usage: optional
	Value type: <empty>
	Definition: specifies, if present, that the als should operate in PWM
		    mode - rather than analog mode

= BACKLIGHT NODES
Backlight subnodes must be named "backlight", they carry the backlight related
properties.

- reg:
	Usage: required
	Value type: <u32>
	Definition: specifies which of the two backlights this node corresponds
		    to

- default-brightness:
	Usage: optional
	Value type: <32>
	Definition: specifies the default brightness for the backlight, in
		    units of brightness [0-255]

- label:
	Usage: required
	Value type: <string>
	Definition: specifies a name of this backlight

- led-max-microamp:
	Usage: required
	Value type: <u32>
	Definition: specifies the max current for this backlight, in uA, as
		    described in "../leds/common.txt"

- ti,pwm-zones:
	Usage: optional
	Value type: <u32 list>
	Definition: lists the ALS zones to be PWM controlled for this backlight,
		    the values in the list are in the range [0 - 4]

= LED NODES
LED subnodes must be named "led", they carry the LED related properties.

- reg:
	Usage: required
	Value type: <u32>
	Definition: specifies which of the four LEDs this node corresponds to

- linux,default-trigger:
	Usage: optional
	Value type: <string>
	Definition: specifies the default trigger for the LED, as described in
		    "../leds/common.txt"

- label:
	Usage: required
	Value type: <string>
	Definition: specifies a name of this LED, as described in
		    "../leds/common.txt"

- led-max-microamp:
	Usage: required
	Value type: <u32>
	Definition: specifies the max current for this LED, in uA, as described
		    in "../leds/common.txt"

- ti,pwm-zones:
	Usage: optional
	Value type: <u32 list>
	Definition: lists the ALS zones to be PWM controlled for this LED, the
		    values in the list are in the range [0 - 4]

= EXAMPLE

i2c@12460000 {
	compatible = "qcom,i2c-qup-v1.1.1";
	...

	lm3533@36 {
		compatible = "ti,lm3533";
		reg = <0x36>;

		als-supply = <&pm8921_l11>;
		hwen-gpios = <&pm8921_gpio 26 GPIO_ACTIVE_HIGH>;

		ti,boost-freq-hz = <500000>;
		ti,boost-ovp-mv = <24000>;

		#address-cells = <1>;
		#size-cells = <0>;

		als {
			ti,als-resistance-ohm = <200000>;
		};

		backlight@0 {
			reg = <0>;
			label = "backlight";

			led-max-microamp = <20200>;
		};

		led@0 {
			reg = <0>;
			label = "red";

			led-max-microamp = <5000>;
		};

		led@1 {
			reg = <1>;
			label = "green";

			led-max-microamp = <5000>;
		};

		led@2 {
			reg = <2>;
			label = "blue";

			led-max-microamp = <5000>;
		};
	};
```

## Documentation/devicetree/bindings/mfd/pm8x41.txt
```
Qualcomm PM8841 and PM8941 PMIC multi-function devices

The PM8x41 PMICs are used with the Qualcomm Snapdragon 800 series SoCs, and are
interfaced to the chip via the SPMI (System Power Management Interface) bus.
Support for  multiple independent functions are implemented by splitting the
16-bit SPMI slave address space into 256 smaller fixed-size regions, 256 bytes
each.  A function can consume one or more of these fixed-size register regions.

Required properties:
- compatible: Must be one of:
     "qcom,pm8841"
     "qcom,pm8941"
- reg: Specifies the SPMI USID slave address for this device
- #address-cells = <1>
- #size-cells = <0>

Each child node represents a function of the PM8x41.  Each child 'reg' entry
describes an offset within the USID slave address where the region starts.

Example:

pm8941@0 {
	compatible = "qcom,pm8941";
	reg = <0x0>;

	#address-cells = <1>;
	#size-cells = <0>;

	rtc {
		compatible = "qcom,pm8941-rtc";
		reg = <0x6000 0x6100>;
	};
}
```

## Documentation/devicetree/bindings/mfd/qcom-rpm-smd.txt
```
Qualcomm Resource Power Manager (RPM) over SMD

This driver is used to interface with the Resource Power Manager (RPM) found in
various Qualcomm platforms. The RPM allows each component in the system to vote
for state of the system resources, such as clocks, regulators and bus
frequencies.

- compatible:
	Usage: required
	Value type: <string>
	Definition: must be one of:
		    "qcom,rpm-msm8974"

- qcom,smd-channels:
	Usage: required
	Value type: <stringlist>
	Definition: Shared Memory Channel used for communication with the RPM

- #address-cells:
	Usage: required
	Value type: <u32>
	Definition: must be 1

- #size-cells:
	Usage: required
	Value type: <u32>
	Definition: must be 0

= SUBDEVICES

The RPM exposes resources to its subnodes. The below bindings specify the set
of valid subnodes that can operate on these resources.

== Switch-mode Power Supply regulator

- compatible:
	Usage: required
	Value type: <string>
	Definition: must be one of:
		    "qcom,rpm-pm8841-smps"
		    "qcom,rpm-pm8941-smps"


- reg:
	Usage: required
	Value type: <u32>
	Definition: resource as defined in <dt-bindings/mfd/qcom-rpm.h>
		    must be one of:
		    QCOM_RPM_PM8841_SMPS1 - QCOM_RPM_PM8841_SMPS4,
		    QCOM_RPM_PM8941_SMPS1 - QCOM_RPM_PM8941_SMPS3

Standard regulator bindings are used inside switch mode power supply subnodes.
Check Documentation/devicetree/bindings/regulator/regulator.txt for more
details.

== Low-dropout regulator

- compatible:
	Usage: required
	Value type: <string>
	Definition: must be one of:
		    "qcom,rpm-pm8941-ldo"

- reg:
	Usage: required
	Value type: <u32>
	Definition: resource as defined in <dt-bindings/mfd/qcom-rpm.h>
		    must be one of:
		    QCOM_RPM_PM8941_LDO1 - QCOM_RPM_PM8941_LDO24

Standard regulator bindings are used inside switch low-dropout regulator
subnodes.  Check Documentation/devicetree/bindings/regulator/regulator.txt for
more details.

== Switch

- compatible:
	Usage: required
	Value type: <string>
	Definition: must be one of:
		    "qcom,rpm-pm8941-switch"

- reg:
	Usage: required
	Value type: <u32>
	Definition: resource as defined in <dt-bindings/mfd/qcom/qcom-rpm.h>
		    must be one of:
		    QCOM_RPM_PM8941_LVS1 - QCOM_RPM_PM8941_LVS3,
		    QCOM_RPM_PM8941_MVS1 - QCOM_RPM_PM8941_MVS2

Standard regulator bindings are used inside switch regulator subnodes.  Check
Documentation/devicetree/bindings/regulator/regulator.txt for more details.

= EXAMPLE

	#include <dt-bindings/mfd/qcom-rpm.h>

	rpm@108000 {
		compatible = "qcom,rpm-msm8960";
		qcom,smd-channels = "rpm_requests";

		#address-cells = <1>;
		#size-cells = <0>;

		pm8941_s1: regulator-s1 {
			compatible = "qcom,rpm-pm8941-smps";
			reg = <QCOM_RPM_PM8941_SMPS1>;

			regulator-min-microvolt = <1300000>;
			regulator-max-microvolt = <1300000>;
		};

		pm8941_l3: pm8941-l3 {
			compatible = "qcom,rpm-pm8941-ldo";
			reg = <QCOM_RPM_PM8941_LDO3>;

			regulator-min-microvolt = <1200000>;
			regulator-max-microvolt = <1200000>;
		};

	};
```
